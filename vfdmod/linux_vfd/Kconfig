## vfdmod/linux_vfd/Kconfig
```kconfig
#
# VFD configuration
#

config VFD_SUPPORT
	tristate "7-segment LED display support"
	default n
	help
	  Say Y here if you want to use the driver for 7-segment
	  LED displays connected to a LED display driver IC like
	  SM1628, FD628 etc.

	  Communication with the driver IC is done via bit-banging
	  several GPIOs.

	  This driver also optionaly provides input via buttons
	  connected to same IC.

	  To compile this driver as a module, choose M here: the
	  module will be called vfd.

config VFD_NO_KEY_INPUT
	tristate "No key input from IC"
	default n
	depends on VFD_SUPPORT
	help
	  Select this option if you don't have any buttons
	  connected to the driver IC. The driver will not
	  create any input device and save a bit in code size.

config VFD_NO_DELAYS
	tristate "Do not insert delays as per datasheet"
	default n
	depends on VFD_SUPPORT
	help
	  If your CPU isn't blazing fast, calling gpio_xxx functions
	  can be slow enough to make the IC happy without extra delays.
	  This option will remove the delays, which is ok in many cases.

choice
	prompt "Display driver IC backend"
	default VFD_PT6964
	depends on VFD_SUPPORT

config VFD_PT6964
	bool "PT6964, SM1628, TM1623, FD268, FD620"
	help
	  PT6964, SM1628, TM1623, FD268 or FD620 is used to drive the
	  7-segment LED displays

endchoice

choice
	prompt "PT6964 display-to-IC connection scheme"
	default VFD_PT6964_X92
	depends on VFD_SUPPORT && VFD_PT6964

config VFD_PT6964_X92
	bool "X92 LED display (FD628)"
	help
	  Connection scheme used on X92 AMlogic S912-based TV boxes

config VFD_PT6964_T95U
	bool "T95U LED display (FD620)"
	help
	  Connection scheme used on T95U AMlogic S912-based TV boxes

endchoice
```
